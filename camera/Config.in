## camera/Config.in
```kconfig
source "$BR2_EXTERNAL_TREEDYS_CAMERA_PATH/package/libbpg/Config.in"
source "$BR2_EXTERNAL_TREEDYS_CAMERA_PATH/package/treedys/camera-app/Config.in"
```

## camera/configs/scanner_camera_defconfig
```kconfig
BR2_arm=y
BR2_cortex_a53=y
BR2_ARM_FPU_NEON_VFPV4=y
BR2_CCACHE=y
BR2_TOOLCHAIN_EXTERNAL=y
BR2_TARGET_GENERIC_HOSTNAME="camera"
BR2_SYSTEM_DHCP="eth0"
BR2_ROOTFS_OVERLAY="$(BR2_EXTERNAL_TREEDYS_CAMERA_PATH)/rootfs-overlay"
BR2_ROOTFS_POST_BUILD_SCRIPT="board/raspberrypi3/post-build.sh $(BR2_EXTERNAL_TREEDYS_CAMERA_PATH)/board/camera/post-build.sh"
BR2_ROOTFS_POST_IMAGE_SCRIPT="$(BR2_EXTERNAL_TREEDYS_CAMERA_PATH)/board/camera/post-image.sh"
BR2_ROOTFS_POST_SCRIPT_ARGS="--add-pi3-miniuart-bt-overlay --gpu_mem_1024=256"
BR2_LINUX_KERNEL=y
BR2_LINUX_KERNEL_CUSTOM_TARBALL=y
BR2_LINUX_KERNEL_CUSTOM_TARBALL_LOCATION="$(call github,raspberrypi,linux,c117a8bccf37bfba323065b566cf999ed4629a4a)/linux-c117a8bccf37bfba323065b566cf999ed4629a4a.tar.gz"
BR2_LINUX_KERNEL_DEFCONFIG="bcm2709"
BR2_LINUX_KERNEL_DTS_SUPPORT=y
BR2_LINUX_KERNEL_INTREE_DTS_NAME="bcm2710-rpi-3-b bcm2710-rpi-3-b-plus bcm2710-rpi-cm3"
BR2_PACKAGE_BUSYBOX_CONFIG_FRAGMENT_FILES="$(BR2_EXTERNAL_TREEDYS_CAMERA_PATH)/configs/busybox_config_fragment"
BR2_PACKAGE_RPI_FIRMWARE=y
BR2_PACKAGE_RPI_FIRMWARE_X=y
BR2_PACKAGE_RPI_USERLAND=y
BR2_PACKAGE_WIRINGPI=y
BR2_PACKAGE_LIBUV=y
BR2_PACKAGE_AVAHI=y
BR2_PACKAGE_AVAHI_DAEMON=y
BR2_PACKAGE_DROPBEAR=y
BR2_PACKAGE_DROPBEAR_DISABLE_REVERSEDNS=y
BR2_TARGET_ROOTFS_INITRAMFS=y
# BR2_TARGET_ROOTFS_TAR is not set
BR2_PACKAGE_HOST_DOSFSTOOLS=y
BR2_PACKAGE_HOST_GENIMAGE=y
BR2_PACKAGE_HOST_MTOOLS=y
BR2_PACKAGE_CAMERA_APP=y
```

## camera/package/libbpg/Config.in
```kconfig
config BR2_PACKAGE_LIBBPG
    bool "libbpg"
    select BR2_PACKAGE_LIBPNG
    select BR2_PACKAGE_JPEG
    help
      BPG (Better Portable Graphics) is a new image format.
      Its purpose is to replace the JPEG image format when
      quality or file size is an issue.

      https://bellard.org/bpg/

if BR2_PACKAGE_LIBBPG

config BR2_PACKAGE_LIBBPG_EMMC
    bool "Javascript BPG decoder"
    help
      Enable compilation of Javascript decoder with Emscripten

config BR2_PACKAGE_LIBBPG_X265
    bool "x265"
    default yes
    select BR2_PACKAGE_HOST_CMAKE
    help
      Enable x265 for the encoder

config BR2_PACKAGE_LIBBPG_JCTVC
    bool "JCTVC"
    help
      Enable the JCTVC code (best quality but slow) for the encoder

if BR2_PACKAGE_LIBBPG_JCTVC

config BR2_PACKAGE_LIBBPG_JCTVC_HIGH_BIT_DEPTH
    bool "JCTVC hogh bit depth"
    help
      Enable it to use bit depths > 12
      (need more tests to validate encoder)

endif

config BR2_PACKAGE_LIBBPG_BPGVIEW
    bool "bpgview"
    select BR2_PACKAGE_SDL
    select BR2_PACKAGE_SDL_IMAGE
    help
      Compile bpgview (SDL and SDL_image libraries needed)

endif
```

## camera/package/treedys/camera-app/Config.in
```kconfig
config BR2_PACKAGE_CAMERA_APP
    bool "camera-app"
    depends on BR2_PACKAGE_RPI_USERLAND
    help
      Treedys Camera application

comment "Treedys Camera application needs RPi userland for OpenMAX"
    depends on !BR2_PACKAGE_RPI_USERLAND

if BR2_PACKAGE_CAMERA_APP

endif
```

## controller/Config.in
```kconfig
source "$BR2_EXTERNAL_TREEDYS_CONTROLLER_PATH/package/treedys/camera-firmware/Config.in"
```

## controller/configs/scanner_controller_defconfig
```kconfig
BR2_aarch64=y
BR2_TOOLCHAIN_BUILDROOT_CXX=y
# BR2_TARGET_GENERIC_GETTY is not set
BR2_ROOTFS_OVERLAY="$(BR2_EXTERNAL_TREEDYS_CONTROLLER_PATH)/rootfs-overlay"
BR2_ROOTFS_POST_IMAGE_SCRIPT="$(BR2_EXTERNAL_TREEDYS_CONTROLLER_PATH)/board/treedys-controller/post-image.sh"
BR2_LINUX_KERNEL=y
BR2_LINUX_KERNEL_USE_ARCH_DEFAULT_CONFIG=y
BR2_LINUX_KERNEL_CONFIG_FRAGMENT_FILES="$(BR2_EXTERNAL_TREEDYS_CONTROLLER_PATH)/board/treedys-controller/kernel_config_fragment"
BR2_LINUX_KERNEL_DTS_SUPPORT=y
BR2_LINUX_KERNEL_INTREE_DTS_NAME="marvell/armada-3720-espressobin"
BR2_LINUX_KERNEL_INSTALL_TARGET=y
BR2_PACKAGE_NODEJS=y
BR2_PACKAGE_NODEJS_NPM=y
BR2_PACKAGE_NODEJS_MODULES_ADDITIONAL="$(shell $(NPM) pack $(BR2_EXTERNAL_TREEDYS_CONTROLLER_PATH)/app | tail -1)"
BR2_PACKAGE_DNSMASQ=y
BR2_TARGET_ROOTFS_EXT2=y
BR2_TARGET_ROOTFS_EXT2_4=y
BR2_TARGET_ROOTFS_EXT2_SIZE="128M"
BR2_TARGET_ROOTFS_EXT2_MKFS_OPTIONS="-O ^64bit -b 4096"
# BR2_TARGET_ROOTFS_TAR is not set
BR2_PACKAGE_HOST_GENIMAGE=y
BR2_PACKAGE_CAMERA_FIRMWARE=y
```

## controller/configs/x86_controller_defconfig
```kconfig
BR2_x86_64=y
BR2_x86_corei7=y
BR2_CCACHE=y
BR2_OPTIMIZE_3=y
BR2_TOOLCHAIN_EXTERNAL=y
BR2_TOOLCHAIN_EXTERNAL_DOWNLOAD=y
BR2_TOOLCHAIN_EXTERNAL_URL="https://toolchains.bootlin.com/downloads/releases/toolchains/x86-64-core-i7/tarballs/x86-64-core-i7--glibc--bleeding-edge-2018.07-3.tar.bz2"
BR2_TOOLCHAIN_EXTERNAL_GCC_8=y
BR2_TOOLCHAIN_EXTERNAL_HEADERS_4_14=y
BR2_TOOLCHAIN_EXTERNAL_CUSTOM_GLIBC=y
BR2_TOOLCHAIN_EXTERNAL_CXX=y
BR2_TARGET_GENERIC_HOSTNAME="scanner"
BR2_ROOTFS_DEVICE_CREATION_DYNAMIC_EUDEV=y
BR2_TARGET_GENERIC_ROOT_PASSWD="test"
BR2_ROOTFS_OVERLAY="$(BR2_EXTERNAL_TREEDYS_CONTROLLER_PATH)/rootfs-overlay $(BR2_EXTERNAL_TREEDYS_CONTROLLER_PATH)/board/x86-controller/rootfs-overlay"
BR2_LINUX_KERNEL=y
BR2_LINUX_KERNEL_USE_CUSTOM_CONFIG=y
BR2_LINUX_KERNEL_CUSTOM_CONFIG_FILE="$(BR2_EXTERNAL_TREEDYS_CONTROLLER_PATH)/board/x86-controller/kernel_config"
BR2_PACKAGE_BUSYBOX_CONFIG_FRAGMENT_FILES="$(BR2_EXTERNAL_TREEDYS_CONTROLLER_PATH)/configs/busybox_config_fragment"
BR2_PACKAGE_BUSYBOX_SHOW_OTHERS=y
BR2_PACKAGE_LINUX_FIRMWARE=y
BR2_PACKAGE_LINUX_FIRMWARE_RTL_8169=y
BR2_PACKAGE_ACPID=y
BR2_PACKAGE_BIOSDEVNAME=y
BR2_PACKAGE_HDPARM=y
BR2_PACKAGE_NODEJS=y
BR2_PACKAGE_NODEJS_NPM=y
BR2_PACKAGE_NODEJS_MODULES_ADDITIONAL="$(shell $(NPM) pack $(BR2_EXTERNAL_TREEDYS_CONTROLLER_PATH)/app | tail -1)"
BR2_PACKAGE_LIBMNL=y
BR2_PACKAGE_AVAHI=y
BR2_PACKAGE_AVAHI_DAEMON=y
BR2_PACKAGE_DNSMASQ=y
BR2_PACKAGE_DROPBEAR=y
BR2_PACKAGE_DROPBEAR_DISABLE_REVERSEDNS=y
BR2_PACKAGE_IPERF3=y
BR2_PACKAGE_VIM=y
BR2_TARGET_ROOTFS_INITRAMFS=y
BR2_TARGET_ROOTFS_ISO9660=y
BR2_TARGET_ROOTFS_ISO9660_HYBRID=y
# BR2_TARGET_ROOTFS_TAR is not set
BR2_TARGET_SYSLINUX=y
BR2_TARGET_SYSLINUX_ISOLINUX=y
BR2_TARGET_SYSLINUX_MBR=y
BR2_PACKAGE_CAMERA_FIRMWARE=y
```

## controller/package/treedys/camera-firmware/Config.in
```kconfig
config BR2_PACKAGE_CAMERA_FIRMWARE
    bool "Treedys Camera firmware"
    depends on BR2_PACKAGE_DNSMASQ
    help
      Builds Treedys Camera Firmware and serves it for network boot via TFTP

comment "Treedys Camera firmware needs dnsmasq for network boot"
    depends on !BR2_PACKAGE_DNSMASQ

if BR2_PACKAGE_CAMERA_FIRMWARE

endif
```
